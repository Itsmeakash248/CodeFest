## FlowPilot-esp32s3/sdkconfig.defaults
```kconfig
# ESP32-S3 + ILI9341 + XPT2046 Profile Configuration
CONFIG_IDF_TARGET="esp32s3"

# Flash Configuration (16MB QIO)
CONFIG_ESPTOOLPY_FLASHSIZE_16MB=y
CONFIG_ESPTOOLPY_FLASHSIZE="16MB"
CONFIG_ESPTOOLPY_FLASHMODE_QIO=y
CONFIG_ESPTOOLPY_FLASHMODE="qio"
CONFIG_ESPTOOLPY_NO_STUB=y

# Custom Partition Table for 16MB Flash with FATFS
CONFIG_PARTITION_TABLE_CUSTOM=y
CONFIG_PARTITION_TABLE_CUSTOM_FILENAME="partitions.csv"
CONFIG_PARTITION_TABLE_FILENAME="partitions.csv"

# PSRAM / SPIRAM Configuration (80MHz Octal PSRAM, XiP from PSRAM, ECC enabled)
CONFIG_SPIRAM=y
CONFIG_SPIRAM_MODE_OCT=y
CONFIG_SPIRAM_TYPE_AUTO=y
CONFIG_SPIRAM_SPEED_80M=y
CONFIG_SPIRAM_XIP_FROM_PSRAM=y
CONFIG_SPIRAM_ECC_ENABLE=y

# Cache Configuration
CONFIG_ESP32S3_INSTRUCTION_CACHE_32KB=y
CONFIG_ESP32S3_DATA_CACHE_64KB=y
CONFIG_ESP32S3_DATA_CACHE_LINE_64B=y

# Console Output via USB Serial/JTAG
CONFIG_ESP_CONSOLE_USB_SERIAL_JTAG=y

# Additional sdkconfig options
CONFIG_LV_CACHE_DEF_SIZE=524288
CONFIG_FATFS_LFN_HEAP=y
CONFIG_FATFS_MAX_LFN=255

# Main Task Stack Configuration
CONFIG_ESP_MAIN_TASK_STACK_SIZE=8192
CONFIG_ESP_INT_WDT_TIMEOUT_MS=1000

# Hardware & Power Configuration
CONFIG_ESP_PHY_RF_CAL_PARTIAL=y
CONFIG_ESP_PHY_ENABLE_USB=y
CONFIG_ESP_PHY_MAX_WIFI_TX_POWER=10
CONFIG_ESP_PHY_MAX_TX_POWER=10
CONFIG_ESP_PHY_REDUCE_TX_POWER=y
CONFIG_ESP_BROWNOUT_DET=n
CONFIG_SPI_FLASH_BROWNOUT_RESET_XMC=n
CONFIG_SPI_FLASH_BROWNOUT_RESET=n
CONFIG_ESP_DEFAULT_CPU_FREQ_MHZ_160=y
CONFIG_ESP_DEFAULT_CPU_FREQ_MHZ=160
CONFIG_FREERTOS_HZ=1000

# FreeRTOS Real-time Run-Time Stats for CPU Usage Monitoring
CONFIG_FREERTOS_GENERATE_RUN_TIME_STATS=y
CONFIG_FREERTOS_USE_TRACE_FACILITY=y
CONFIG_FREERTOS_USE_STATS_FORMATTING_FUNCTIONS=y
CONFIG_FREERTOS_RUN_TIME_COUNTER_TYPE_U64=y
```
